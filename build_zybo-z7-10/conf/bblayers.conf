## build_zybo-z7-10/conf/bblayers.conf
```bitbake
BBPATH = "${TOPDIR}"
BBFILES ?= ""

BBLAYERS ?= " \
  /home/ssen03/edf/AMD_EDF/sources/poky/meta \
  /home/ssen03/edf/AMD_EDF/sources/poky/meta-poky \
  /home/ssen03/edf/AMD_EDF/sources/poky/../meta-xilinx/meta-microblaze \
  /home/ssen03/edf/AMD_EDF/sources/poky/../meta-xilinx/meta-xilinx-core \
  /home/ssen03/edf/AMD_EDF/sources/poky/../meta-xilinx/meta-xilinx-standalone \
  /home/ssen03/edf/AMD_EDF/sources/poky/../meta-xilinx/meta-xilinx-standalone-sdt \
  /home/ssen03/edf/AMD_EDF/sources/poky/../meta-xilinx/meta-xilinx-bsp \
  /home/ssen03/edf/AMD_EDF/sources/poky/../meta-xilinx/meta-xilinx-vendor \
  /home/ssen03/edf/AMD_EDF/sources/poky/../meta-xilinx/meta-xilinx-virtualization \
  /home/ssen03/edf/AMD_EDF/sources/poky/../meta-xilinx/meta-xilinx-mali400 \
  /home/ssen03/edf/AMD_EDF/sources/poky/../meta-xilinx/meta-xilinx-demos \
  /home/ssen03/edf/AMD_EDF/sources/poky/../meta-xilinx/meta-xilinx-multimedia \
  /home/ssen03/edf/AMD_EDF/sources/poky/../meta-xilinx-tools \
  /home/ssen03/edf/AMD_EDF/sources/poky/../meta-amd-adaptive-socs/meta-amd-adaptive-socs-core \
  /home/ssen03/edf/AMD_EDF/sources/poky/../meta-amd-adaptive-socs/meta-amd-adaptive-socs-bsp \
  /home/ssen03/edf/AMD_EDF/sources/poky/../meta-arm/meta-arm \
  /home/ssen03/edf/AMD_EDF/sources/poky/../meta-arm/meta-arm-toolchain \
  /home/ssen03/edf/AMD_EDF/sources/poky/../meta-openembedded/meta-perl \
  /home/ssen03/edf/AMD_EDF/sources/poky/../meta-openembedded/meta-python \
  /home/ssen03/edf/AMD_EDF/sources/poky/../meta-openembedded/meta-filesystems \
  /home/ssen03/edf/AMD_EDF/sources/poky/../meta-openembedded/meta-gnome \
  /home/ssen03/edf/AMD_EDF/sources/poky/../meta-openembedded/meta-multimedia \
  /home/ssen03/edf/AMD_EDF/sources/poky/../meta-openembedded/meta-networking \
  /home/ssen03/edf/AMD_EDF/sources/poky/../meta-openembedded/meta-webserver \
  /home/ssen03/edf/AMD_EDF/sources/poky/../meta-openembedded/meta-xfce \
  /home/ssen03/edf/AMD_EDF/sources/poky/../meta-openembedded/meta-initramfs \
  /home/ssen03/edf/AMD_EDF/sources/poky/../meta-openembedded/meta-oe \
  /home/ssen03/edf/AMD_EDF/sources/poky/../meta-xilinx/meta-xilinx-contrib \
  /home/ssen03/edf/AMD_EDF/sources/poky/../meta-virtualization \
  /home/ssen03/edf/AMD_EDF/sources/poky/../meta-kria \
  /home/ssen03/edf/AMD_EDF/sources/poky/../meta-security \
  /home/ssen03/edf/AMD_EDF/sources/poky/../meta-security/meta-tpm \
  /home/ssen03/edf/AMD_EDF/sources/poky/../meta-xilinx-tsn \
  /home/ssen03/edf/AMD_EDF/sources/poky/../meta-petalinux \
  /home/ssen03/edf/AMD_EDF/sources/poky/../meta-openamp \
  /home/ssen03/edf/AMD_EDF/sources/poky/../meta-qt5 \
  /home/ssen03/edf/AMD_EDF/sources/poky/../meta-aws \
  /home/ssen03/edf/AMD_EDF/sources/poky/../meta-jupyter \
  /home/ssen03/edf/AMD_EDF/sources/poky/../meta-rauc \
  /home/ssen03/edf/AMD_EDF/sources/poky/../meta-ros/meta-ros-common \
  /home/ssen03/edf/AMD_EDF/sources/poky/../meta-ros/meta-ros2 \
  /home/ssen03/edf/AMD_EDF/sources/poky/../meta-ros/meta-ros2-jazzy \
  /home/ssen03/edf/AMD_EDF/sources/poky/../meta-embedded-plus \
"
```
